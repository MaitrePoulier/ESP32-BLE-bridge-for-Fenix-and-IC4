## Firmware/main/Kconfig.projbuild
```kconfig
menu "ESP32-Base-IC4 console"

    config CONSOLE_MAX_COMMAND_LINE_LENGTH
        int "Maximum command line length"
        default 256
        help
            This value marks the maximum length of a single command line. Once it is
            reached, no more characters will be accepted by the console.

endmenu
```
